## boards/flowink_esp32s3/Kconfig.flowink_esp32s3
```kconfig
# Copyright (c) 2024 Espressif Systems (Shanghai) Co., Ltd.
# SPDX-License-Identifier: Apache-2.0

config BOARD_FLOWINK_ESP32S3
	select SOC_ESP32S3_WROOM_N16
	select SOC_ESP32S3_PROCPU if BOARD_FLOWINK_ESP32S3_ESP32S3_PROCPU
	select SOC_ESP32S3_APPCPU if BOARD_FLOWINK_ESP32S3_ESP32S3_APPCPU
```

## boards/flowink_esp32s3/board.yml
```yaml
board:
  name: flowink_esp32s3
  full_name: FlowInk ESP32-S3
  vendor: espressif
  socs:
  - name: esp32s3
```
